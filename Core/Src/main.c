/* USER CODE BEGIN Header */
/**
 ******************************************************************************
 * @file           : main.c
 * @brief          : Main program body
 ******************************************************************************
 * @attention
 *
 * Copyright (c) 2023 STMicroelectronics.
 * All rights reserved.
 *
 * This software is licensed under terms that can be found in the LICENSE file
 * in the root directory of this software component.
 * If no LICENSE file comes with this software, it is provided AS-IS.
 *
 ******************************************************************************
 */
/* USER CODE END Header */
/* Includes ------------------------------------------------------------------*/
#include "main.h"

/* Private includes ----------------------------------------------------------*/
/* USER CODE BEGIN Includes */

/* USER CODE END Includes */

/* Private typedef -----------------------------------------------------------*/
/* USER CODE BEGIN PTD */

/* USER CODE END PTD */

/* Private define ------------------------------------------------------------*/
/* USER CODE BEGIN PD */

#define ADC_BUF_LEN 64
#define NChirp 64
#define ARM_MATH_CM4
#include "arm_math.h"
#include "arm_const_structs.h"
#include <stdio.h>

/* USER CODE END PD */

/* Private macro -------------------------------------------------------------*/
/* USER CODE BEGIN PM */

/* USER CODE END PM */

/* Private variables ---------------------------------------------------------*/
ADC_HandleTypeDef hadc1;
DMA_HandleTypeDef hdma_adc1;

UART_HandleTypeDef huart2;

/* USER CODE BEGIN PV */
volatile uint32_t adc_buf[ADC_BUF_LEN];
uint8_t Rx[1];

//
float fftIn[NChirp][ADC_BUF_LEN] = {
		{-2.5863e-07,0.00022521,-6.1129e-05,-0.00042889,-0.00063372,-0.00045172,0.00013064,0.0008364,0.00119,0.0008174,-0.00025078,-0.0014703,-0.002018,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4.2643e-05,0.00010846},
		{-0.00011764,0.00017898,-0.00012513,-0.00047058,-0.00061149,-0.00035661,0.00025963,0.00091687,0.0011498,0.00063762,-0.00048411,-0.0016101,-0.0019384,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7.1105e-05,0.00011804},
		{-0.00011015,0.00012903,-0.00018696,-0.00050252,-0.00057733,-0.00025347,0.00038414,0.00097933,0.00108,0.00044542,-0.00070618,-0.0017144,-0.0018181,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9.7596e-05,0.00012337},
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		{3.4716e-05,-0.00024135,1.7958e-05,0.00037933,0.00059375,0.00042827,-0.00013715,-0.00080782,-0.001098,-0.00065852,0.00041924,0.0015154,0.0018095,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-0.00021854,-0.0001177}


};

//float fftIn[NChirp][ADC_BUF_LEN];
float fftOut[NChirp][ADC_BUF_LEN];
float fft2In[ADC_BUF_LEN/2][2*NChirp];


arm_rfft_fast_instance_f32 fftHandler;
arm_cfft_instance_f32 TwofftHandler;

/* USER CODE END PV */

/* Private function prototypes -----------------------------------------------*/
void SystemClock_Config(void);
static void MX_GPIO_Init(void);
static void MX_DMA_Init(void);
static void MX_ADC1_Init(void);
static void MX_USART2_UART_Init(void);
/* USER CODE BEGIN PFP */

/* USER CODE END PFP */

/* Private user code ---------------------------------------------------------*/
/* USER CODE BEGIN 0 */

uint8_t callback_state = 0;
uint8_t uartfree = 1;

float complexABS(float real, float compl) {
	return sqrtf(real*real + compl*compl);
}

void DoFFT(){

	for(int d =0; d<NChirp; d++){

		arm_rfft_fast_f32(&fftHandler, &fftIn[d], &fftOut[d], 0);

	}


	int n = 0;
	int j = -2;

	for(int m = 0; m < ADC_BUF_LEN/2; m++){
		j = j + 2;

		for( int k = 0; k < NChirp; k++){
			for(int i = 0; i<2; i++,j++,n++){
				fft2In[m][n] = fftOut[k][j];
			}
			j = j-2;
		}
		n = 0;
		//arm_cfft_f32(&arm_cfft_sR_f32_len64, &fft2In[m], 0, 1);
	}

	for(int e = 0; e<ADC_BUF_LEN/2; e++){
	arm_cfft_f32(&arm_cfft_sR_f32_len64, &fft2In[e], 0, 1);
	}

	float freqs[ADC_BUF_LEN/2][NChirp];
	int freqvalues = 0;
	int chirp = 0;
	int offset = 0;
	int c = 0;
	int p = 0;
	int i = 0;
	int m = 0;
	float outarray[ADC_BUF_LEN/2][NChirp];
	char temp_buf[200];

	for( m = 0; m<ADC_BUF_LEN/2; m++){

		for ( i = 0; i < 2*NChirp; i = i+2) {
			freqs[chirp][freqvalues] = (20*log10f(complexABS(fft2In[m][i], fft2In[m][i+1]))) - offset;
			if(freqs[chirp][freqvalues] < 0) freqs[chirp][freqvalues] = 0;

			freqs[chirp][0] = 0;

			outarray[p][c] = freqs[chirp][freqvalues];
			freqvalues++;
			c++;
		}
		freqvalues = 0;
		c = 0;
		i = 0;
		chirp++;
		p++;
	}

	float max = 0;
	float max1 = 0;
	float max2 = 0;

	int maxrow = -1;
	int maxcol = -1;

	int max1row = -1;
	int max1col = -1;

	int max2row = -1;
	int max2col = -1;

	float velocity = 0.00f;
	float range = 0.00f;

	for(int m=0; m<ADC_BUF_LEN/2; m++){
		for(int n=0; n<NChirp; n++){
			if(outarray[m][n]> max){

				max2 = max1;
				max1 = max;
				max = outarray[m][n];
				maxrow = m;
				maxcol = n;
			}

			else if(outarray[m][n]> max1){

				max2 = max1;
				max1 = outarray[m][n];
				max1row = m;
				max1col = n;
			}

			else if(outarray[m][n]> max2){

				max2 = outarray[m][n];
				max2row = m;
				max2col = n;
			}

		}
	}

	range = 0.375 * maxrow;

	if(maxcol<=7){
		 velocity = maxcol * 9.15 * 2;
	}
	else{
//		 velocity = (-1 *(16 - ((maxcol + 1) * 0.5))) * 9.15;
		 velocity = (-1 *(16 - maxcol)) * 9.15 * 2;
	}

	snprintf(temp_buf, sizeof(temp_buf), "%f %f %d %d\r\n", range, velocity, maxcol, maxrow);
	HAL_UART_Transmit(&huart2, (uint8_t*)temp_buf, strlen(temp_buf), HAL_MAX_DELAY);


	HAL_GPIO_WritePin(LD2_GPIO_Port, LD2_Pin, GPIO_PIN_RESET);


}
/* USER CODE END 0 */

/**
 * @brief  The application entry point.
 * @retval int
 */
int main(void)
{
	/* USER CODE BEGIN 1 */

	/* USER CODE END 1 */

	/* MCU Configuration--------------------------------------------------------*/

	/* Reset of all peripherals, Initializes the Flash interface and the Systick. */
	HAL_Init();

	/* USER CODE BEGIN Init */

	/* USER CODE END Init */

	/* Configure the system clock */
	SystemClock_Config();

	/* USER CODE BEGIN SysInit */

	/* USER CODE END SysInit */

	/* Initialize all configured peripherals */
	MX_GPIO_Init();
	MX_DMA_Init();
	MX_ADC1_Init();
	MX_USART2_UART_Init();
	/* USER CODE BEGIN 2 */



	arm_rfft_fast_init_f32(&fftHandler, 64);

	//HAL_ADC_Start_DMA(&hadc1, (uint32_t*)adc_buf, ADC_BUF_LEN);
	DoFFT();
	/* USER CODE END 2 */

	/* Infinite loop */
	/* USER CODE BEGIN WHILE */
	while (1)
	{
		/* USER CODE END WHILE */

		/* USER CODE BEGIN 3 */



//		if(callback_state == 1){
//
//					for(int Ci = 0; Ci < NChirp; Ci++){
//						int fft_in_ptr = 0;
//						for( int Si = 0; Si < ADC_BUF_LEN; Si++){
//
//							fftIn[Ci][fft_in_ptr] = (float32_t) adc_buf[Si];
//							fft_in_ptr++;
//						}
//						//arm_rfft_fast_f32(&fftHandler, &fftIn[Ci], &fftOut[Ci], 0);
//					}


//					HAL_GPIO_WritePin(LD2_GPIO_Port, LD2_Pin, GPIO_PIN_RESET);
//		}
	}
	/* USER CODE END 3 */
}



/**
 * @brief System Clock Configuration
 * @retval None
 */
void SystemClock_Config(void)
{
	RCC_OscInitTypeDef RCC_OscInitStruct = {0};
	RCC_ClkInitTypeDef RCC_ClkInitStruct = {0};

	/** Configure the main internal regulator output voltage
	 */
	if (HAL_PWREx_ControlVoltageScaling(PWR_REGULATOR_VOLTAGE_SCALE1) != HAL_OK)
	{
		Error_Handler();
	}
	/** Initializes the RCC Oscillators according to the specified parameters
	 * in the RCC_OscInitTypeDef structure.
	 */
	RCC_OscInitStruct.OscillatorType = RCC_OSCILLATORTYPE_HSI;
	RCC_OscInitStruct.HSIState = RCC_HSI_ON;
	RCC_OscInitStruct.HSICalibrationValue = RCC_HSICALIBRATION_DEFAULT;
	RCC_OscInitStruct.PLL.PLLState = RCC_PLL_ON;
	RCC_OscInitStruct.PLL.PLLSource = RCC_PLLSOURCE_HSI;
	RCC_OscInitStruct.PLL.PLLM = 1;
	RCC_OscInitStruct.PLL.PLLN = 10;
	RCC_OscInitStruct.PLL.PLLP = RCC_PLLP_DIV7;
	RCC_OscInitStruct.PLL.PLLQ = RCC_PLLQ_DIV2;
	RCC_OscInitStruct.PLL.PLLR = RCC_PLLR_DIV2;
	if (HAL_RCC_OscConfig(&RCC_OscInitStruct) != HAL_OK)
	{
		Error_Handler();
	}
	/** Initializes the CPU, AHB and APB buses clocks
	 */
	RCC_ClkInitStruct.ClockType = RCC_CLOCKTYPE_HCLK|RCC_CLOCKTYPE_SYSCLK
			|RCC_CLOCKTYPE_PCLK1|RCC_CLOCKTYPE_PCLK2;
	RCC_ClkInitStruct.SYSCLKSource = RCC_SYSCLKSOURCE_PLLCLK;
	RCC_ClkInitStruct.AHBCLKDivider = RCC_SYSCLK_DIV1;
	RCC_ClkInitStruct.APB1CLKDivider = RCC_HCLK_DIV1;
	RCC_ClkInitStruct.APB2CLKDivider = RCC_HCLK_DIV1;

	if (HAL_RCC_ClockConfig(&RCC_ClkInitStruct, FLASH_LATENCY_4) != HAL_OK)
	{
		Error_Handler();
	}
}

/**
 * @brief ADC1 Initialization Function
 * @param None
 * @retval None
 */
static void MX_ADC1_Init(void)
{

	/* USER CODE BEGIN ADC1_Init 0 */

	/* USER CODE END ADC1_Init 0 */

	ADC_MultiModeTypeDef multimode = {0};
	ADC_ChannelConfTypeDef sConfig = {0};

	/* USER CODE BEGIN ADC1_Init 1 */

	/* USER CODE END ADC1_Init 1 */
	/** Common config
	 */
	hadc1.Instance = ADC1;
	hadc1.Init.ClockPrescaler = ADC_CLOCK_ASYNC_DIV1;
	hadc1.Init.Resolution = ADC_RESOLUTION_12B;
	hadc1.Init.DataAlign = ADC_DATAALIGN_RIGHT;
	hadc1.Init.ScanConvMode = ADC_SCAN_DISABLE;
	hadc1.Init.EOCSelection = ADC_EOC_SINGLE_CONV;
	hadc1.Init.LowPowerAutoWait = DISABLE;
	hadc1.Init.ContinuousConvMode = ENABLE;
	hadc1.Init.NbrOfConversion = 1;
	hadc1.Init.DiscontinuousConvMode = DISABLE;
	hadc1.Init.ExternalTrigConv = ADC_SOFTWARE_START;
	hadc1.Init.ExternalTrigConvEdge = ADC_EXTERNALTRIGCONVEDGE_NONE;
	hadc1.Init.DMAContinuousRequests = ENABLE;
	hadc1.Init.Overrun = ADC_OVR_DATA_PRESERVED;
	hadc1.Init.OversamplingMode = DISABLE;
	if (HAL_ADC_Init(&hadc1) != HAL_OK)
	{
		Error_Handler();
	}
	/** Configure the ADC multi-mode
	 */
	multimode.Mode = ADC_MODE_INDEPENDENT;
	if (HAL_ADCEx_MultiModeConfigChannel(&hadc1, &multimode) != HAL_OK)
	{
		Error_Handler();
	}
	/** Configure Regular Channel
	 */
	sConfig.Channel = ADC_CHANNEL_5;
	sConfig.Rank = ADC_REGULAR_RANK_1;
	sConfig.SamplingTime = ADC_SAMPLETIME_2CYCLES_5;
	sConfig.SingleDiff = ADC_SINGLE_ENDED;
	sConfig.OffsetNumber = ADC_OFFSET_NONE;
	sConfig.Offset = 0;
	if (HAL_ADC_ConfigChannel(&hadc1, &sConfig) != HAL_OK)
	{
		Error_Handler();
	}
	/* USER CODE BEGIN ADC1_Init 2 */

	/* USER CODE END ADC1_Init 2 */

}

/**
 * @brief USART2 Initialization Function
 * @param None
 * @retval None
 */
static void MX_USART2_UART_Init(void)
{

	/* USER CODE BEGIN USART2_Init 0 */

	/* USER CODE END USART2_Init 0 */

	/* USER CODE BEGIN USART2_Init 1 */

	/* USER CODE END USART2_Init 1 */
	huart2.Instance = USART2;
	huart2.Init.BaudRate = 115200;
	huart2.Init.WordLength = UART_WORDLENGTH_8B;
	huart2.Init.StopBits = UART_STOPBITS_1;
	huart2.Init.Parity = UART_PARITY_NONE;
	huart2.Init.Mode = UART_MODE_TX_RX;
	huart2.Init.HwFlowCtl = UART_HWCONTROL_NONE;
	huart2.Init.OverSampling = UART_OVERSAMPLING_16;
	huart2.Init.OneBitSampling = UART_ONE_BIT_SAMPLE_DISABLE;
	huart2.AdvancedInit.AdvFeatureInit = UART_ADVFEATURE_NO_INIT;
	if (HAL_UART_Init(&huart2) != HAL_OK)
	{
		Error_Handler();
	}
	/* USER CODE BEGIN USART2_Init 2 */

	/* USER CODE END USART2_Init 2 */

}

/**
 * Enable DMA controller clock
 */
static void MX_DMA_Init(void)
{

	/* DMA controller clock enable */
	__HAL_RCC_DMA1_CLK_ENABLE();

	/* DMA interrupt init */
	/* DMA1_Channel1_IRQn interrupt configuration */
	HAL_NVIC_SetPriority(DMA1_Channel1_IRQn, 0, 0);
	HAL_NVIC_EnableIRQ(DMA1_Channel1_IRQn);

}

/**
 * @brief GPIO Initialization Function
 * @param None
 * @retval None
 */
static void MX_GPIO_Init(void)
{
	GPIO_InitTypeDef GPIO_InitStruct = {0};

	/* GPIO Ports Clock Enable */
	__HAL_RCC_GPIOC_CLK_ENABLE();
	__HAL_RCC_GPIOH_CLK_ENABLE();
	__HAL_RCC_GPIOA_CLK_ENABLE();
	__HAL_RCC_GPIOB_CLK_ENABLE();

	/*Configure GPIO pin Output Level */
	HAL_GPIO_WritePin(LD2_GPIO_Port, LD2_Pin, GPIO_PIN_RESET);

	/*Configure GPIO pin : B1_Pin */
	GPIO_InitStruct.Pin = B1_Pin;
	GPIO_InitStruct.Mode = GPIO_MODE_IT_FALLING;
	GPIO_InitStruct.Pull = GPIO_NOPULL;
	HAL_GPIO_Init(B1_GPIO_Port, &GPIO_InitStruct);

	/*Configure GPIO pin : LD2_Pin */
	GPIO_InitStruct.Pin = LD2_Pin;
	GPIO_InitStruct.Mode = GPIO_MODE_OUTPUT_PP;
	GPIO_InitStruct.Pull = GPIO_NOPULL;
	GPIO_InitStruct.Speed = GPIO_SPEED_FREQ_LOW;
	HAL_GPIO_Init(LD2_GPIO_Port, &GPIO_InitStruct);

}

/* USER CODE BEGIN 4 */
void HAL_ADC_ConvHalfCpltCallback(ADC_HandleTypeDef* hadc) {

	//callback_state = 1;

	//	HAL_ADC_Stop_DMA(&hadc1);
	//
	//	int fft_in_ptr = 0;
	//
	//	if(callback_state == 1){
	//		for(int i =0; i<2048; i++){
	//
	//			fftBufIn[fft_in_ptr] = (float32_t) adc_buf[i];
	//			fft_in_ptr++;
	//		}
	//
	//		DoFFT();
	//	}
	//	NVIC_SystemReset();
}

void HAL_ADC_ConvCpltCallback(ADC_HandleTypeDef* hadc) {


	callback_state = 1;
	//HAL_ADC_Stop_DMA(&hadc1);

	//	int fft_in_ptr = 0;
	//
	//
	//
	//	if(callback_state == 2){
	//		for(int i =2048; i<4096; i++){
	//
	//			fftBufIn[i] = (float32_t) adc_buf[i];
	//			fft_in_ptr++;
	//		}
	//
	//		DoFFT();
	//	}

}
/* USER CODE END 4 */

/**
 * @brief  This function is executed in case of error occurrence.
 * @retval None
 */
void Error_Handler(void)
{
	/* USER CODE BEGIN Error_Handler_Debug */
	/* User can add his own implementation to report the HAL error return state */
	__disable_irq();
	while (1)
	{
	}
	/* USER CODE END Error_Handler_Debug */
}

#ifdef  USE_FULL_ASSERT
/**
 * @brief  Reports the name of the source file and the source line number
 *         where the assert_param error has occurred.
 * @param  file: pointer to the source file name
 * @param  line: assert_param error line source number
 * @retval None
 */
void assert_failed(uint8_t *file, uint32_t line)
{
	/* USER CODE BEGIN 6 */
	/* User can add his own implementation to report the file name and line number,
     ex: printf("Wrong parameters value: file %s on line %d\r\n", file, line) */
	/* USER CODE END 6 */
}
#endif /* USE_FULL_ASSERT */

